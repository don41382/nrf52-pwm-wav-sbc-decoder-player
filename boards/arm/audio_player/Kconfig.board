## boards/arm/audio_player/Kconfig.board
```kconfig
# Copyright (c) 2021 Nordic Semiconductor ASA
# SPDX-License-Identifier: Apache-2.0

config BOARD_AUDIO_PLAYER
	bool "audio_player"
	depends on SOC_NRF52840_QIAA
```

## boards/arm/audio_player/Kconfig.defconfig
```kconfig
# Copyright (c) 2021 Nordic Semiconductor ASA
# SPDX-License-Identifier: Apache-2.0

if BOARD_AUDIO_PLAYER

config BOARD
	default "audio_player"

config BT_CTLR
   default BT

endif
```
